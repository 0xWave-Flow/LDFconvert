VERSION ""

NS_ :

BS_:

BU_: LockingSystem Gateway
VAL_TABLE_ Passanger 1 "Passanger2" 0 "Passanger1" ;
VAL_TABLE_ Ignition 1 "On" 0 "Off" ;
VAL_TABLE_ DoorLockingSystem 1 "Open" 0 "Close" ;

BO_ 665 CarLockingSystem: 1 LockingSystem
 SG_ ActualState : 0|1@1+ (1,0) [0|0] ""  Gateway

BO_ 819 Ignition: 1 LockingSystem
 SG_ PowerOn : 0|1@1+ (1,0) [0|1] ""  Gateway

BO_ 768 Driver_ID: 1 LockingSystem
 SG_ StoreSeatposition : 2|1@1+ (1,0) [0|0] ""  Gateway
 SG_ Driver : 0|2@1+ (1,0) [0|0] ""  Gateway

BA_DEF_ SG_  "GenSigSendType" ENUM  "Cyclic","OnWrite","OnWriteWithRepetition","OnChange","OnChangeWithRepetition","IfActive","IfActiveWithRepetition","NoSigSendType","NotUsed","NotUsed","NotUsed","NotUsed","NotUsed";
BA_DEF_ SG_  "GenSigEnvVarType" ENUM  "int","float","undef";
BA_DEF_ BO_  "GenMsgSendType" ENUM  "Cyclic","NotUsed","NotUsed","NotUsed","NotUsed","Cyclic","NotUsed","IfActive","NoMsgSendType","NotUsed","vector_leerstring";
BA_DEF_ BO_  "GenMsgDelayTime" INT 0 1000;
BA_DEF_ BO_  "GenMsgCycleTime" INT 0 50000;
BA_DEF_ BO_  "GenMsgILSupport" ENUM  "No","Yes";
BA_DEF_ BU_  "ILUsed" ENUM  "No","Yes";
BA_DEF_ BU_  "NodeLayerModules" STRING ;
BA_DEF_  "GenEnvVarEndingDsp" STRING ;
BA_DEF_  "GenEnvVarEndingSnd" STRING ;
BA_DEF_  "GenEnvVarPrefix" STRING ;
BA_DEF_  "BusType" STRING ;
BA_DEF_DEF_  "GenSigSendType" "Cyclic";
BA_DEF_DEF_  "GenSigEnvVarType" "undef";
BA_DEF_DEF_  "GenMsgSendType" "NoMsgSendType";
BA_DEF_DEF_  "GenMsgDelayTime" 0;
BA_DEF_DEF_  "GenMsgCycleTime" 0;
BA_DEF_DEF_  "GenMsgILSupport" "Yes";
BA_DEF_DEF_  "ILUsed" "Yes";
BA_DEF_DEF_  "NodeLayerModules" "CANoeILNLVector.dll";
BA_DEF_DEF_  "GenEnvVarEndingDsp" "Dsp_";
BA_DEF_DEF_  "GenEnvVarEndingSnd" "_";
BA_DEF_DEF_  "GenEnvVarPrefix" "Env";
BA_DEF_DEF_  "BusType" "CAN";
BA_ "GenMsgCycleTime" BO_ 665 150;
BA_ "GenMsgCycleTime" BO_ 819 100;
BA_ "GenMsgDelayTime" BO_ 819 50;
BA_ "GenMsgCycleTime" BO_ 768 150;
BA_ "GenSigSendType" SG_ 768 StoreSeatposition 1;
VAL_ 665 ActualState 1 "Open" 0 "Close" ;
VAL_ 819 PowerOn 1 "On" 0 "Off" ;
VAL_ 768 Driver 1 "Passanger2" 0 "Passanger1" ;
