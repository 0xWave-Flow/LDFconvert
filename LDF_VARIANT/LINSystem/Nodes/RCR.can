/*@!Encoding:65001*/
variables
{
  const int kCLOSE = 0x00;
  const int kOPEN  = 0x01;
}

on sysvar sysvar::RemoteKey::KeyClose
{
  if(@sysvar::Door::OpenDoorLeft)  return;

  if(@sysvar::RemoteKey::KeyClose) 
  {
   $RCR_01::RCR_CentralLockingSystem = kCLOSE;
  }
}

on sysvar sysvar::RemoteKey::KeyOpen
{
  if(@sysvar::RemoteKey::KeyOpen) 
  {
    linWakeup();
    $RCR_01::RCR_CentralLockingSystem = kOPEN;
  }
}

on sysvar sysvar::RemoteKey::KeyPassenger
{
  if((@sysvar::RemoteKey::KeyPassenger == 1 || @sysvar::RemoteKey::KeyPassenger == 2) &&  $RCR_01::RCR_CentralLockingSystem == kOPEN)  
    $RCR_01::RCR_Passanger = @sysvar::RemoteKey::KeyPassenger;
}

