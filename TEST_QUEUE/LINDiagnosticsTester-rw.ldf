/* This is the example convert Excel format to LDF format */

LIN_description_file;
LIN_protocol_version = "2.2";
LIN_language_version = "2.2";
LIN_speed = 19.2 kbps;

Nodes {
  Master: LINMaster, 1 ms, 0.1 ms;
  Slaves: FrontLeftDoor, RearLeftDoor;
}

Signals {
  FrontLeftDoorSignal: 8, 0, FrontLeftDoor, LINMaster ;
  FrontLeftDoorErrSig: 1, 0, FrontLeftDoor, LINMaster ;
  RearLeftDoorSignal: 8, 0, RearLeftDoor, LINMaster ;
  RearLeftDoorErrSig: 1, 0, RearLeftDoor, LINMaster ;
}

Frames {
  FrontLeftDoorMessage: 1, FrontLeftDoor, 2 {
    FrontLeftDoorSignal, 0;
    FrontLeftDoorErrSig, 8;
  }
  RearLeftDoorMessage: 2, RearLeftDoor, 2 {
    RearLeftDoorSignal, 0;
    RearLeftDoorErrSig, 8;
  }
}

Node_attributes {
  FrontLeftDoor {
    LIN_protocol = "2.2";
    configured_NAD = 0x7;
    product_id = 0x1e, 0x2, 0;
    response_error = FrontLeftDoorErrSig;
    P2_min = 51 ms;
    ST_min = 2 ms;
    N_As_timeout = 1001 ms;
    N_Cr_timeout = 1002 ms;
    configurable_frames {
      FrontLeftDoorMessage;
    }
  }
  RearLeftDoor {
    LIN_protocol = "2.2";
    configured_NAD = 0x8;
    product_id = 0x1e, 0x3, 0;
    response_error = RearLeftDoorErrSig;
    P2_min = 51 ms;
    ST_min = 2 ms;
    N_As_timeout = 1001 ms;
    N_Cr_timeout = 1002 ms;
    configurable_frames {
      RearLeftDoorMessage;
    }
  }
}

Schedule_tables {
  MasterReq_Table {
    MasterReq delay 10 ms;
  }
  SlaveResp_Table {
    SlaveResp delay 10 ms;
  }
  Diagnostic {
    MasterReq delay 10 ms;
    SlaveResp delay 10 ms;
  }
  Initialisation {
    AssignFrameId {FrontLeftDoor, FrontLeftDoorMessage} delay 10 ms;
  }
  Send {
    FrontLeftDoorMessage delay 5 ms;
    RearLeftDoorMessage delay 5 ms;
  }
}
